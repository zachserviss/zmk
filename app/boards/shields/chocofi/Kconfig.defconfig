## app/boards/shields/urchin/Kconfig.shield
```kconfig
# Copyright (c) 2020 The ZMK Contributors
# SPDX-License-Identifier: MIT

config SHIELD_URCHIN_LEFT
    def_bool $(shields_list_contains,urchin_left)

config SHIELD_URCHIN_RIGHT
    def_bool $(shields_list_contains,urchin_right)
```
